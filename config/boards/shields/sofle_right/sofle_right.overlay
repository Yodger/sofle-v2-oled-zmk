&i2c1 {
    status = "okay";

    trackpad@42 {
        compatible = "cirque,tps43";
        reg = <0x42>;
        label = "CIRQUE_TPS43";
        irq-gpios = <&gpio0 10 GPIO_ACTIVE_LOW>; // ← 이 값을 실제 IRQ 핀으로 변경해야 함
        status = "okay";
    };
};
